## drivers/input/touchscreen/L11a_fts_spi/Kconfig
```kconfig
# SPDX-License-Identifier: GPL-2.0
config TOUCHSCREEN_ST_FTS_V521_SPI_L11A
	tristate "ST/FocalTech FTS v5.2.1 SPI touchscreen (Xiaomi l11a)"
	depends on SPI
	depends on INPUT_TOUCHSCREEN
	help
	  Say Y here for the FocalTech (ST Microelectronics FTS) capacitive
	  touchscreen controller attached over SPI.  This is the panel/touch
	  combination used on the Xiaomi Redmi K50 (rubens), which ships
	  firmware "st_fts_L11a.ftb" (embedded in fts_fw.h).

	  If unsure, say N.
```

## drivers/media/platform/mediatek/camsv/Kconfig
```kconfig
# SPDX-License-Identifier: GPL-2.0-only

config VIDEO_MTK_CAMSV
	tristate "Mediatek CAMSV capture driver (MT6895 bring-up)"
	depends on VIDEO_DEV && VIDEO_V4L2
	depends on ARCH_MEDIATEK || COMPILE_TEST
	depends on OF && IOMMU_SUPPORT
	help
	  Self-contained CAMSV1 capture driver for the MT6895 (Redmi K50, rubens)
	  camera path: IMX582 -> CSI-2 port 2 -> SENINF -> CAM_MUX 3 -> camsv1 IMGO
	  DMA -> V4L2 /dev/video0 (YUYV 422).  The driver programs the sensor over
	  I2C itself, so no separate sensor or CSI-2 receiver driver is needed.

	  This is bring-up quality code; the capture buffer is allocated from CMA
	  and mapped through the display IOMMU.

	  To compile this driver as a module, choose M here: the module will be
	  called cam_cap.
```

## drivers/media/platform/mediatek/isp/isp71/Kconfig
```kconfig
# SPDX-License-Identifier: GPL-2.0-only

config VIDEO_MTK_SENINF71
	tristate "MediaTek MT6895 SENINF camera sensor interface"
	depends on V4L_PLATFORM_DRIVERS
	depends on ARCH_MEDIATEK || COMPILE_TEST
	depends on OF && PM && VIDEO_DEV
	select GENERIC_PHY
	select GENERIC_PHY_MIPI_DPHY
	select MEDIA_CONTROLLER
	select V4L2_FWNODE
	select VIDEO_V4L2_SUBDEV_API
	help
	  MIPI CSI-2 receiver (SENINF) of the MediaTek MT6895 camera
	  subsystem. It routes the data of the camera sensors to the CAMSV
	  engines and provides the media device of the camera pipeline.

	  To compile this driver as a module, choose M here: the module
	  will be called mtk-seninf71.
```

## drivers/misc/mediatek/ccci/Kconfig
```kconfig
# SPDX-License-Identifier: GPL-2.0-only
config MTK_CCCI_MD
	tristate "MediaTek MT6895 CCCI / modem bring-up"
	depends on ARCH_MEDIATEK || COMPILE_TEST
	depends on PM
	depends on REGULATOR
	help
	  Minimal mainline driver for the MediaTek CCCI / modem (MD) block on
	  MT6895 (Dimensity 8100).  It brings up the modem rails and the MD
	  power domain, releases the modem CPU from reset through the stock
	  ATF SIP call, reads the LK boot tag table out of the reserved
	  ccci_tag_mem region and then polls CCIF0 for the first handshake.

	  The modem firmware itself is loaded by the bootloader (LK), not by
	  this driver.

	  Say M here if you want to bring up the cellular modem on such a
	  device.  If unsure, say N.
```
